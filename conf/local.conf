## conf/local.conf
```bitbake
# We expect to get LOCAL_BUILD_DIR and OPENEMBEDDED_DIR from the environment

# MACHINE can be specified in the environment to override the default
#MACHINE ?= "at91sam9263ek"
#MACHINE ?= "at91sam9g20ek"
MACHINE ?= "walnut"


# WARNING: ccache causes build problems, make sure it's disabled
CCACHE=""

# uncomment this line if running on a Ubuntu 8.10 machine
#BUILD_CPPFLAGS += "-Wno-format-security -U_FORTIFY_SOURCE"

# use a common download directory on /mnt/sdev
DL_DIR = "/tools/sources/"

DEBIAN_MIRROR = "ftp://ftp.us.debian.org/pub/debian/pool"

# Set up where the recipe files can be found
#BBFILES = "${OPENEMBEDDED_DIR}/recipes/*/*.bb"
# allow a local recipes directory
BBFILES = "${OPENEMBEDDED_DIR}/recipes/*/*.bb ${LOCAL_BUILD_DIR}/recipes/*/*.bb"
BBFILE_COLLECTIONS = "openembedded local"
BBFILE_PATTERN_openembedded = "^${OPENEMBEDDED_DIR}/recipes/"
BBFILE_PATTERN_local = "^${LOCAL_BUILD_DIR}/recipes/"
BBFILE_PRIORITY_openembedded = "5"
BBFILE_PRIORITY_local = "10"
BBMASK = ""

DISTRO = "kaeilos"

# Uncomment these if you have multi-core and if you know what you are doing.
#BB_NUMBER_THREADS = "8"
PARALLEL_MAKE = "-j 2"

ASSUME_PROVIDED += "git-native"
BBINCLUDELOGS = "yes"

OE_STRICT_CHECKSUMS=""

IMAGE_FSTYPES += "tar.bz2 jffs2"

DEPLOY_DIR_PSTAGE   = "${LOCAL_BUILD_DIR}/pstage/"

# Use the build directory toolchain

TOOLCHAIN_OPTIONS = " --sysroot=${STAGING_DIR_HOST}"
TARGET_CXXFLAGS_append = " -I${STAGING_DIR_HOST}/usr/include/c++ -I${STAGING_DIR_HOST}/usr/include/c++/${TARGET_SYS}"

# Use the pre-built toolchain -- the toolchain must be in the PATH

#ASSUME_PROVIDED += " virtual/${TARGET_PREFIX}gcc "
#ASSUME_PROVIDED += " virtual/libc "
#TOOLCHAIN_OPTIONS = " --sysroot=${TOOLCHAIN_DIR}"
#TARGET_CXXFLAGS_append = " -I${TOOLCHAIN_DIR}/usr/include/c++ -I${TOOLCHAIN_DIR}/usr/include/c++/${TARGET_SYS} "


# So far, angstrom.conf sets ENABLE_BINARY_LOCALE_GENERATION
# to generate binary locale packages at build time using qemu-native and
# thereby guarantee i18n support on all devices. If your build breaks on 
# qemu-native consider disabling ENABLE_BINARY_LOCALE_GENERATION (note that
# this breaks i18n on devices with less than 128MB RAM) or installing
# a working third-party qemu (e.g. provided by your distribution) and
# adding qemu-native to ASSUME_PROVIDED. Caveat emptor, since third-party
# qemus lack patches needed to work with various OE targets.
ENABLE_BINARY_LOCALE_GENERATION = "0"
# ASSUME_PROVIDED += "qemu-native"

# If ENABLE_BINARY_LOCALE_GENERATION is set to "1", you can limit locales
# generated to the list provided by GLIBC_GENERATE_LOCALES. This is huge
# time-savior for developmental builds. Format: list of locale.encoding pairs
# with spaces as separators.
# GLIBC_GENERATE_LOCALES = "en_US.UTF-8"
```

## conf/machine/walnut.conf
```bitbake
#@TYPE: Machine
#@Name: Dust Walnut Platform
#@DESCRIPTION: Machine configuration for the Dust Walnut board with a at91sam9g20 processor and a ST nand flash

TARGET_ARCH = "arm"
# TODO: replace with dust feeds
DISTRO_FEED_CONFIGS = "angstrom-feed-configs"

PREFERRED_PROVIDER_virtual/kernel = "linux"
PREFERRED_VERSION_linux = "2.6.28"
PREFERRED_PROVIDER_xserver = "xserver-kdrive"

KERNEL_IMAGETYPE = "uImage"
PREFERRED_VERSION_u-boot = "2009.01"
UBOOT_MACHINE = "at92sam9g20ek_config"

PREFERRED_VERSION_at91bootstrap = "2.10"

# Serial configuration used by sysvinit-inittab
# No virtual terminals
USE_VT = "0"
# parameters for console port
SERIAL_CONSOLE = "-L ttyS0 115200"

MACHINE_FEATURES = "kernel26 ext2 usbhost usbgadget"
#EXTRA_IMAGEDEPENDS += "u-boot"
#EXTRA_IMAGEDEPENDS += "at91bootstrap"

IMAGE_FSTYPES ?= "jffs2"
EXTRA_IMAGECMD_jffs2 = "--pad --little-endian --eraseblock=0x4000 -n"

require conf/machine/include/tune-arm926ejs.inc
```
